/*
 * On-device gesture inference: MPU6050 (I2C) -> sliding 1-second window ->
 * quantized TensorFlow Lite Micro model -> predicted gesture over Serial.
 *
 * Uses ArduTFLite (a thin Arduino-style wrapper around TensorFlow Lite Micro,
 * via the Chirale_TensorFlowLite port) so this compiles on ESP32 without
 * needing the board-specific IMU libraries the official TFLite Micro
 * "magic wand" example assumes (that one targets Arduino Nano 33 BLE only).
 *
 * gesture_model_data.h and gesture_labels.h are generated by
 * ../../model/train.py -- do not hand-edit them, retrain instead.
 *
 * Model input/output contract (must match train.py exactly):
 *   input:  300 floats = 50 timesteps x [ax, ay, az, gx, gy, gz]
 *           ax/ay/az in g (not m/s^2), gx/gy/gz in deg/s (not rad/s)
 *   output: 4 floats = softmax probabilities in the order of kGestureLabels
 *           ("idle", "wave", "circle", "punch")
 *
 * Wiring: see ../../wiring/WIRING_GUIDE.md.
 */
#include <Wire.h>
#include <Adafruit_MPU6050.h>
#include <Adafruit_Sensor.h>
#include <ArduTFLite.h>

#include "gesture_model_data.h"
#include "gesture_labels.h"

#define SAMPLE_RATE_HZ 50
#define SAMPLES_PER_WINDOW 50   // 1 second, must match train.py's SAMPLES_PER_WINDOW
#define AXES_PER_SAMPLE 6       // ax, ay, az, gx, gy, gz
#define INFER_EVERY_N_SAMPLES 10  // run inference 5x/sec on the sliding window
#define CONFIDENCE_THRESHOLD 0.6

// TensorFlow Lite Micro's scratch memory for input/output/intermediate tensors.
// Sized by trial and error -- this model is tiny (2 dense layers, 15.8KB
// quantized) so 10KB is generous headroom, not a tuned minimum.
constexpr int kTensorArenaSize = 10 * 1024;
alignas(16) byte tensorArena[kTensorArenaSize];

Adafruit_MPU6050 mpu;

// ring buffer holding the most recent SAMPLES_PER_WINDOW readings
float windowBuf[SAMPLES_PER_WINDOW][AXES_PER_SAMPLE];
int writeIdx = 0;
int samplesInBuf = 0;
int samplesSinceInfer = 0;

void setup() {
  Serial.begin(115200);
  while (!Serial) { delay(10); }

  Wire.begin();
  if (!mpu.begin()) {
    Serial.println("MPU6050 not found -- check wiring (SDA=21, SCL=22, VCC=3V3)");
    while (1) { delay(1000); }
  }
  mpu.setAccelerometerRange(MPU6050_RANGE_4_G);
  mpu.setGyroRange(MPU6050_RANGE_500_DEG);
  mpu.setFilterBandwidth(MPU6050_BAND_44_HZ);

  Serial.println("initializing model...");
  if (!modelInit(g_gesture_model_data, tensorArena, kTensorArenaSize)) {
    Serial.println("model init failed -- tensorArenaSize is probably too small");
    while (1) { delay(1000); }
  }
  Serial.println("model ready. move the board to see predictions.");
}

void loop() {
  static unsigned long lastSampleMs = 0;
  unsigned long now = millis();
  if (now - lastSampleMs < (1000 / SAMPLE_RATE_HZ)) return;
  lastSampleMs = now;

  sensors_event_t a, g, temp;
  mpu.getEvent(&a, &g, &temp);

  // same unit conversions as data_collector.ino -- must match training data
  windowBuf[writeIdx][0] = a.acceleration.x / 9.80665;
  windowBuf[writeIdx][1] = a.acceleration.y / 9.80665;
  windowBuf[writeIdx][2] = a.acceleration.z / 9.80665;
  windowBuf[writeIdx][3] = g.gyro.x * 57.2958;
  windowBuf[writeIdx][4] = g.gyro.y * 57.2958;
  windowBuf[writeIdx][5] = g.gyro.z * 57.2958;

  writeIdx = (writeIdx + 1) % SAMPLES_PER_WINDOW;
  if (samplesInBuf < SAMPLES_PER_WINDOW) samplesInBuf++;
  samplesSinceInfer++;

  if (samplesInBuf < SAMPLES_PER_WINDOW || samplesSinceInfer < INFER_EVERY_N_SAMPLES) {
    return;
  }
  samplesSinceInfer = 0;

  // oldest sample in the ring buffer is at writeIdx (about to be overwritten next)
  int idx = writeIdx;
  int flat = 0;
  for (int s = 0; s < SAMPLES_PER_WINDOW; s++) {
    for (int ax = 0; ax < AXES_PER_SAMPLE; ax++) {
      modelSetInput(windowBuf[idx][ax], flat);
      flat++;
    }
    idx = (idx + 1) % SAMPLES_PER_WINDOW;
  }

  if (!modelRunInference()) {
    Serial.println("inference failed");
    return;
  }

  int bestIdx = 0;
  float bestScore = 0.0;
  for (int i = 0; i < kNumGestureClasses; i++) {
    float score = modelGetOutput(i);
    if (score > bestScore) {
      bestScore = score;
      bestIdx = i;
    }
  }

  if (bestScore >= CONFIDENCE_THRESHOLD) {
    Serial.print(kGestureLabels[bestIdx]);
    Serial.print(" (");
    Serial.print(bestScore * 100, 1);
    Serial.println("%)");
  }
}
